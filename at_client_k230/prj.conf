## CMakeLists.txt
```
#
# Copyright (c) 2018 Nordic Semiconductor
#
# SPDX-License-Identifier: LicenseRef-Nordic-5-Clause
#

cmake_minimum_required(VERSION 3.20.0)

find_package(Zephyr REQUIRED HINTS $ENV{ZEPHYR_BASE})
project(k230_at_client)

target_sources(app PRIVATE src/main.c)
```

## prj.conf
```kconfig
#
# K230 nRF9151 AT Client firmware.
#
# This follows Nordic NCS v3.4.0 nrf/samples/cellular/at_client and keeps the
# K230-specific UART/log/heartbeat behavior in this tracked repository.
#

# TF-M config
CONFIG_TFM_PROFILE_TYPE_MINIMAL=y

# General config
CONFIG_ASSERT=y
CONFIG_GPIO=y
CONFIG_PRINTK=y
CONFIG_SERIAL=y
CONFIG_UART_CONSOLE=y
CONFIG_LOG=y
CONFIG_LOG_BACKEND_UART=y
CONFIG_LOG_PRINTK=y

# Keep UART1 available to the non-secure application for K230 log output.
CONFIG_TFM_LOG_LEVEL_SILENCE=y
CONFIG_TFM_SECURE_UART=n

# Network
CONFIG_NETWORKING=y
CONFIG_NET_NATIVE=n
CONFIG_NET_SOCKETS=y
CONFIG_NET_SOCKETS_OFFLOAD=y
CONFIG_POSIX_API=y

# Modem library
CONFIG_NRF_MODEM_LIB=y

# AT host library
CONFIG_AT_HOST_LIBRARY=y
CONFIG_UART_INTERRUPT_DRIVEN=y
CONFIG_AT_HOST_LOG_LEVEL_INF=y

# Stacks and heaps
CONFIG_MAIN_STACK_SIZE=3072
CONFIG_HEAP_MEM_POOL_SIZE=16384
CONFIG_AT_MONITOR_HEAP_SIZE=512
```

## boards/nrf9151dk_nrf9151_ns.overlay
```dts
/*
 * Copyright (c) 2026 Nordic Semiconductor ASA
 *
 * SPDX-License-Identifier: LicenseRef-Nordic-5-Clause
 */

#include <samples/cellular/nrf91_no_bootloader_partitions.dtsi>
#include <samples/cellular/nrf91_sram_partitions.dtsi>
```

## src/main.c
```c
/*
 * Copyright (c) 2018 Nordic Semiconductor ASA
 *
 * SPDX-License-Identifier: LicenseRef-Nordic-5-Clause
 */

#include <zephyr/kernel.h>
#include <stdio.h>
#include <string.h>
#include <modem/nrf_modem_lib.h>
#include <zephyr/drivers/gpio.h>
#include <zephyr/drivers/uart.h>
#include <zephyr/drivers/clock_control.h>
#include <zephyr/drivers/clock_control/nrf_clock_control.h>

#define RUN_LED_NODE DT_ALIAS(k230_run_led)

#if DT_NODE_HAS_STATUS(RUN_LED_NODE, okay)
static const struct gpio_dt_spec run_led = GPIO_DT_SPEC_GET(RUN_LED_NODE, gpios);

static void k230_run_led_thread(void *arg1, void *arg2, void *arg3)
{
	ARG_UNUSED(arg1);
	ARG_UNUSED(arg2);
	ARG_UNUSED(arg3);

	if (!gpio_is_ready_dt(&run_led)) {
		printk("K230 run LED GPIO is not ready\n");
		return;
	}

	if (gpio_pin_configure_dt(&run_led, GPIO_OUTPUT_INACTIVE) != 0) {
		printk("K230 run LED GPIO configure failed\n");
		return;
	}

	while (true) {
		gpio_pin_set_dt(&run_led, 1);
		k_sleep(K_MSEC(300));
		gpio_pin_set_dt(&run_led, 0);
		k_sleep(K_MSEC(700));
	}
}

K_THREAD_DEFINE(k230_run_led_tid, 512, k230_run_led_thread,
		NULL, NULL, NULL, 7, 0, 0);
#endif

#if defined(CONFIG_CLOCK_CONTROL_NRF)
/* To strictly comply with UART timing, enable external XTAL oscillator. */
void enable_xtal(void)
{
	struct onoff_manager *clk_mgr;
	static struct onoff_client cli = {};

	clk_mgr = z_nrf_clock_control_get_onoff(CLOCK_CONTROL_NRF_SUBSYS_HF);
	sys_notify_init_spinwait(&cli.notify);
	(void)onoff_request(clk_mgr, &cli);
}
#endif /* CONFIG_CLOCK_CONTROL_NRF */

int main(void)
{
	int err;

	printk("K230 nRF9151 AT host started\n");

	err = nrf_modem_lib_init();
	if (err) {
		printk("Modem library initialization failed, error: %d\n", err);
		return 0;
	}

#if defined(CONFIG_CLOCK_CONTROL_NRF)
	enable_xtal();
#endif /* CONFIG_CLOCK_CONTROL_NRF */

	printk("K230 nRF9151 AT host ready\n");

	return 0;
}
```
